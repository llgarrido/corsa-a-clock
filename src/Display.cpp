#include "Display.h"
#include "Settings.h"

static constexpr uint8_t VIRTUAL_PIXEL_SIZE = 2;      // virtual pixel size (in real pixels)
static constexpr uint8_t VIRTUAL_PIXELS_GAP_SIZE = 1; // gap between virtual pixels
static constexpr uint8_t CHARACTER_WIDTH = 14;        // character width (5 virtual pixels + spacing)
static constexpr uint8_t CHARACTER_HEIGHT = 23;       // character height (8 virtual pixels + spacing)
static constexpr uint8_t CHARACTER_GAP = 2;           // gap between characters (in real pixels)
static constexpr uint8_t ROW_HEIGHT = 25;             // row height (character height + extra spacing to fill 128px)

// 5x8 HD44780-style font. Each row is a 5-bit mask (bit4=col0 left, bit0=col4 right).
static const uint8_t charMap[45][8] = {
    {0x0E, 0x11, 0x11, 0x11, 0x11, 0x11, 0x0E, 0x00}, // 0
    {0x04, 0x0C, 0x04, 0x04, 0x04, 0x04, 0x0E, 0x00}, // 1
    {0x0E, 0x11, 0x01, 0x02, 0x04, 0x08, 0x1F, 0x00}, // 2
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    {0x00, 0x1F, 0x1F, 0x1F, 0x1F, 0x00, 0x1F, 0x1F}  // '~' monochrome separator inspired by classic Opel merchandising
};

Display::Display(uint8_t cs, uint8_t dc, uint8_t rst, uint8_t bl)
    : _tft(cs, dc, rst),
      _backlightPin(bl)
{
}

void Display::backlight(bool on)
{
  digitalWrite(_backlightPin, on ? HIGH : LOW);
}

void Display::clearBuffer()
{
  memset(_buffer, 0, sizeof(_buffer));
}

void Display::clear()
{
  _tft.fillScreen(ST77XX_BLACK);
  clearBuffer();
}

byte Display::begin()
{
  pinMode(_backlightPin, OUTPUT);
  // Turn off backlight before initializing
  backlight(false);
  _tft.initR(INITR_BLACKTAB);
  _tft.setRotation(1);
  clear();
  // Turn on backlight with clean screen
  backlight(true);
  return 0;
}

void Display::drawChar(int16_t x, int16_t y, const uint8_t *bitmap, uint16_t onColor, uint16_t offColor)
{
  _tft.fillRect(x, y, CHARACTER_WIDTH, CHARACTER_HEIGHT, ST77XX_BLACK);
  for (int row = 0; row < 8; row++)
  {
    uint8_t bits = bitmap[row];
    for (int col = 0; col < 5; col++)
    {
      bool on = (bits >> (4 - col)) & 1;
      _tft.fillRect(
          x + col * (VIRTUAL_PIXEL_SIZE + VIRTUAL_PIXELS_GAP_SIZE),
          y + row * (VIRTUAL_PIXEL_SIZE + VIRTUAL_PIXELS_GAP_SIZE),
          VIRTUAL_PIXEL_SIZE, VIRTUAL_PIXEL_SIZE,
          on ? onColor : offColor);
    }
  }
}

int Display::charToIndex(char character)
{
  if (character >= '0' && character <= '9')
    return character - '0';
  if (character >= 'A' && character <= 'Z')
    return character - 'A' + 10;
  if (character >= 'a' && character <= 'z')
    return character - 'a' + 10;
  if (character == ' ')
    return 36;
  if (character == '.')
    return 37;
  if (character == '-')
    return 38;
  if (character == '=')
    return 39;
  if (character == ':')
    return 40;
  if (character == '*')
    return 41;
  if (character == '|')
    return 42;
  if (character == '#')
    return 43;
  if (character == '~')
    return 44;
  return -1;
}

void Display::drawChar(int16_t x, int16_t y, char character, uint16_t onColor, uint16_t offColor)
{
  int idx = charToIndex(character);
  if (idx >= 0)
  {
    drawChar(x, y, charMap[idx], onColor, offColor);
  }
}

void Display::write(int16_t col, int16_t row, const char *text)
{
  int16_t y = 2 + ROW_HEIGHT * row;
  int16_t i = 0;
  while (text[i] && (col + i) < COLS)
  {
    if (row < ROWS && _buffer[row][col + i] != text[i])
    {
      int16_t x = (col + i) * (CHARACTER_WIDTH + CHARACTER_GAP);
      drawChar(x, y, text[i], Settings::Display::OnColor, Settings::Display::OffColor);
      _buffer[row][col + i] = text[i];
    }
    i++;
  }
}

void Display::write(TextAlignment alignment, int16_t row, const char *text)
{
  int16_t textLength = 0;
  while (text[textLength] && textLength < COLS)
  {
    textLength++;
  }

  int16_t col = 0;
  switch (alignment)
  {
  case Center:
    col = (COLS - textLength + 1) / 2;
    break;
  case Right:
    col = COLS - textLength;
    break;
  case Left:
  default:
    col = 0;
    break;
  }

  char line[COLS + 1];
  for (int16_t i = 0; i < COLS; i++)
  {
    line[i] = ' ';
  }
  line[COLS] = '\0';

  for (int16_t i = 0; i < textLength && (col + i) < COLS; i++)
  {
    line[col + i] = text[i];
  }

  write(0, row, line);
}
